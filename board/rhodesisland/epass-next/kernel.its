## board/rhodesisland/epass-next/kernel.its
```
/*
 * FIT holding a gzipped kernel and the board dtb.
 *
 * RISC-V has no self-decompressing image and U-Boot's booti will not take a
 * compressed one, so compression has to come from the container: bootm
 * inflates the kernel into memory itself. That is worth roughly 44% of the
 * kernel partition -- 8.3M of Image becomes about 4.7M here.
 *
 * load/entry sit at 0x40200000, the same place the FEL path pushes a raw
 * Image to, which keeps one address to remember rather than two.
 *
 * No dtb here: the device trees live in their own bundle (dtbs.itb, built by
 * mkdt.sh) because which one to use depends on the board revision and panel
 * recorded in the bootenv partition, and U-Boot has to layer overlays over it
 * before booting. Both FITs share the boot partition -- dtbs in a 1M slot at
 * the front, this one right after.
 */
/dts-v1/;

/ {
	description = "Arknights ePass Next (D1s)";
	#address-cells = <1>;

	images {
		kernel {
			description = "Linux";
			data = /incbin/("./Image.gz");
			type = "kernel";
			arch = "riscv";
			os = "linux";
			compression = "gzip";
			load = <0x40200000>;
			entry = <0x40200000>;
			hash {
				algo = "crc32";
			};
		};
	};

	configurations {
		default = "conf";

		conf {
			description = "Linux";
			kernel = "kernel";
		};
	};
};
```

## configs/epass_next_defconfig
```kconfig
BR2_riscv=y
BR2_RISCV_ISA_RVC=y
BR2_RISCV_ISA_EXTRA="xtheadba_xtheadbb_xtheadbs_xtheadcmo_xtheadcondmov_xtheadfmemidx_xtheadmac_xtheadmemidx_xtheadmempair_xtheadsync_xtheadvector"
BR2_TOOLCHAIN_BUILDROOT_MUSL=y
BR2_KERNEL_HEADERS_7_0=y
BR2_TARGET_OPTIMIZATION="-mtune=thead-c906"
BR2_GLOBAL_PATCH_DIR="board/rhodesisland/epass-next/patches"
BR2_ROOTFS_DEVICE_CREATION_DYNAMIC_MDEV=y
BR2_TARGET_GENERIC_GETTY_PORT="ttyS3"
BR2_TARGET_GENERIC_GETTY_BAUDRATE_115200=y
BR2_ROOTFS_OVERLAY="board/rhodesisland/epass-next/overlay"
BR2_ROOTFS_POST_IMAGE_SCRIPT="board/rhodesisland/epass-next/post-image.sh"
BR2_LINUX_KERNEL=y
BR2_LINUX_KERNEL_CUSTOM_VERSION=y
BR2_LINUX_KERNEL_CUSTOM_VERSION_VALUE="7.1.6"
BR2_LINUX_KERNEL_USE_CUSTOM_CONFIG=y
BR2_LINUX_KERNEL_CUSTOM_CONFIG_FILE="board/rhodesisland/epass-next/linux.config"
BR2_LINUX_KERNEL_DTS_SUPPORT=y
BR2_LINUX_KERNEL_INTREE_DTS_NAME="allwinner/sun20i-d1s-epass-next"
BR2_PACKAGE_EPASS_DRM_APP=y
BR2_PACKAGE_EPASS_APPLICATIONS=y
BR2_PACKAGE_EPASS_FONTS=y
BR2_PACKAGE_EPASS_TOOLS=y
BR2_PACKAGE_EPASSCTL=y
BR2_PACKAGE_USB_AIO_HANDLER=y
BR2_PACKAGE_MTD=y
BR2_PACKAGE_EVTEST=y
BR2_PACKAGE_BUSYBOX_SHOW_OTHERS=y
BR2_PACKAGE_I2C_TOOLS=y
BR2_PACKAGE_CH32_TOUCH_FIRMWARE=y
BR2_PACKAGE_EPASS_BMC_FIRMWARE=y
BR2_PACKAGE_TINYALSA=y
BR2_PACKAGE_TINYALSA_TOOLS=y
BR2_PACKAGE_JPEG_TURBO=y
BR2_PACKAGE_LIBDRM=y
BR2_PACKAGE_LIBDRM_INSTALL_TESTS=y
BR2_PACKAGE_LIBEVDEV=y
BR2_TARGET_ROOTFS_CPIO=y
BR2_TARGET_ROOTFS_UBI=y
BR2_TARGET_ROOTFS_UBI_SUBSIZE=2048
BR2_TARGET_ROOTFS_UBI_USE_CUSTOM_CONFIG=y
BR2_TARGET_ROOTFS_UBI_CUSTOM_CONFIG_FILE="board/rhodesisland/epass-next/ubinize.cfg"
BR2_TARGET_ROOTFS_UBIFS_LEBSIZE=0x1f000
BR2_TARGET_ROOTFS_UBIFS_MAXLEBCNT=198
BR2_TARGET_ROOTFS_UBIFS_LZO=y
BR2_TARGET_OPENSBI=y
BR2_TARGET_OPENSBI_CUSTOM_VERSION=y
BR2_TARGET_OPENSBI_CUSTOM_VERSION_VALUE="1.9"
BR2_TARGET_OPENSBI_PLAT="generic"
# BR2_TARGET_OPENSBI_INSTALL_JUMP_IMG is not set
BR2_TARGET_UBOOT=y
BR2_TARGET_UBOOT_BUILD_SYSTEM_KCONFIG=y
BR2_TARGET_UBOOT_CUSTOM_VERSION=y
BR2_TARGET_UBOOT_CUSTOM_VERSION_VALUE="2026.07"
BR2_TARGET_UBOOT_USE_CUSTOM_CONFIG=y
BR2_TARGET_UBOOT_CUSTOM_CONFIG_FILE="board/rhodesisland/epass-next/uboot.config"
BR2_TARGET_UBOOT_DEFAULT_ENV_FILE="board/rhodesisland/epass-next/uboot.env"
BR2_TARGET_UBOOT_NEEDS_DTC=y
BR2_TARGET_UBOOT_NEEDS_PYLIBFDT=y
BR2_TARGET_UBOOT_NEEDS_OPENSSL=y
BR2_TARGET_UBOOT_NEEDS_OPENSBI=y
# BR2_TARGET_UBOOT_FORMAT_BIN is not set
BR2_TARGET_UBOOT_FORMAT_CUSTOM=y
BR2_TARGET_UBOOT_FORMAT_CUSTOM_NAME="u-boot.itb spl/sunxi-spl.bin"
BR2_TARGET_UBOOT_CUSTOM_DTS_PATH="board/rhodesisland/epass-next/devicetree/uboot/sun20i-d1s-epass-next.dts"
BR2_PACKAGE_HOST_ENVIRONMENT_SETUP=y
BR2_PACKAGE_HOST_GENIMAGE=y
BR2_PACKAGE_HOST_MTD=y
BR2_PACKAGE_HOST_UBOOT_TOOLS=y
BR2_PACKAGE_HOST_UBOOT_TOOLS_FIT_SUPPORT=y
BR2_PACKAGE_HOST_UBOOT_TOOLS_ENVIMAGE=y
BR2_PACKAGE_HOST_UBOOT_TOOLS_ENVIMAGE_SIZE="0x20000"
BR2_PACKAGE_HOST_USB_AIO_HANDLER=y
```

## package/ch32-touch-firmware/Config.in
```kconfig
config BR2_PACKAGE_CH32_TOUCH_FIRMWARE
	bool "ch32-touch-firmware"
	depends on BR2_PACKAGE_HOST_WCH_RISCV_TOOLCHAIN_SUPPORTS
	help
	  Build the latest CH32V006 touch-controller firmware with its
	  own WCH bare-metal toolchain. Installs ch32-touch.bin and
	  its version/hash manifest into images, not the Linux rootfs.
	  Updating the controller remains an explicit touch OTA action.
```

## package/epass-bmc-firmware/Config.in
```kconfig
config BR2_PACKAGE_EPASS_BMC_FIRMWARE
	bool "epass-bmc-firmware"
	depends on BR2_PACKAGE_HOST_ESP_IDF_SUPPORTS
	depends on BR2_TARGET_UBOOT
	select BR2_PACKAGE_HOST_ESP_IDF
	help
	  Build the ESP32-C3 BMC with a pinned, isolated ESP-IDF SDK.
	  Install ESP firmware and its manifest into images/esp only.
	  ESP OTA and USB updates remain explicitly selected actions.
```

## package/epass-tools/Config.in
```kconfig
config BR2_PACKAGE_EPASS_TOOLS
	bool "epass-tools"
	help
	  Board-specific diagnostic tools for ePass Next:
	  - cedrus-probe: inspect Cedrus V4L2 formats and buffer layouts
	  - rot-probe: exercise and verify the sun8i-rotate device
	  - vectest: verify and benchmark the xtheadvector (RVV 0.7.1)
	    kernel plumbing and musl string routines on the C906
```

## package/epass_applications/Config.in
```kconfig
config BR2_PACKAGE_EPASS_APPLICATIONS
	bool "epass applications"
	depends on BR2_TOOLCHAIN_HAS_THREADS
	depends on BR2_USE_MMU
	depends on BR2_USE_WCHAR
	select BR2_PACKAGE_DOSFSTOOLS
	select BR2_PACKAGE_DOSFSTOOLS_MKFS_FAT
	select BR2_PACKAGE_E2FSPROGS
	select BR2_PACKAGE_EPASS_FONTS
	select BR2_PACKAGE_FREETYPE
	select BR2_PACKAGE_LIBDRM
	select BR2_PACKAGE_LIBPNG
	select BR2_PACKAGE_LVGL
	select BR2_PACKAGE_SRGNVDEC
	help
	  Applications for the Electronic Pass, installed below /app.

	  https://github.com/rhodesepass/epass-applications

comment "epass applications needs a toolchain w/ threads, wchar, MMU"
	depends on !BR2_TOOLCHAIN_HAS_THREADS || !BR2_USE_WCHAR || !BR2_USE_MMU
```

## package/epass_drm_app/Config.in
```kconfig
config BR2_PACKAGE_EPASS_DRM_APP
	bool "epass_drm_app"
	select BR2_PACKAGE_LVGL
	select BR2_PACKAGE_SRGNVDEC
	help
	  Electronic Pass main program.

	  https://github.com/rhodesepass/drm_app_neo
```

## package/epassctl/Config.in
```kconfig
config BR2_PACKAGE_EPASSCTL
	bool "epassctl"
	help
	  Electronic Pass CLI for epass_drm_app.

	  https://github.com/rhodesepass/epassctl
```

## package/esp-idf/Config.in.host
```kconfig
config BR2_PACKAGE_HOST_ESP_IDF_SUPPORTS
	bool
	default y if BR2_HOSTARCH = "x86_64"
	help
	  The pinned toolchain and Python wheels require Linux x86_64.

config BR2_PACKAGE_HOST_ESP_IDF
	bool "host esp-idf"
	depends on BR2_PACKAGE_HOST_ESP_IDF_SUPPORTS
	select BR2_PACKAGE_HOST_PYTHON3
	select BR2_PACKAGE_HOST_PYTHON3_SSL
	help
	  ESP-IDF 6.0.2 with its own ESP32-C3 compiler and isolated
	  Python environment. All downloads are versioned and checked
	  against their hashes.
```

## package/lvgl/Config.in
```kconfig
config BR2_PACKAGE_LVGL
	bool "lvgl"
	depends on BR2_TOOLCHAIN_HAS_THREADS
	select BR2_PACKAGE_FREETYPE
	select BR2_PACKAGE_LIBPNG
	select BR2_PACKAGE_JPEG
	help
	  LVGL (Light and Versatile Graphics Library) built as a shared
	  library against a fixed lv_conf.h shipped by this package.

	  Backends enabled: FreeType text, libpng, libjpeg-turbo JPEG,
	  QR code. Consumers link -llvgl and pull the same lv_conf.h from
	  the sysroot, so all users share one ABI.

	  https://lvgl.io

comment "lvgl needs a toolchain w/ threads"
	depends on !BR2_TOOLCHAIN_HAS_THREADS
```

## package/srgnvdec/Config.in
```kconfig
config BR2_PACKAGE_SRGNVDEC
	bool "srgnvdec"
	help
	  Allwinner cedrus stateless H.264 decode stack: mp4 demux,
	  NAL/SPS/PPS/slice parser, DPB reordering and the V4L2 request
	  API decode engine. Outputs dmabuf fds for zero-copy scanout.

	  Split out of drm_app_neo so both product lines and other
	  video-decoding programs share one copy.

	  https://github.com/rhodesepass/srgnvdec

if BR2_PACKAGE_SRGNVDEC

config BR2_PACKAGE_SRGNVDEC_TOOLS
	bool "srgnvdec_play (minimal player / bring-up tool)"
	depends on BR2_PACKAGE_LIBDRM
	default y
	help
	  Standalone player that runs the whole chain without the app:
	  mp4 -> parse -> DPB -> cedrus decode -> DRM plane. Useful for
	  bring-up and for telling decode bugs apart from app bugs.

comment "srgnvdec_play needs libdrm"
	depends on !BR2_PACKAGE_LIBDRM

endif
```

## package/usb_aio_handler/Config.in
```kconfig
config BR2_PACKAGE_USB_AIO_HANDLER
	bool "usb_aio_handler"
	depends on BR2_TOOLCHAIN_HAS_THREADS
	help
	  All-in-one USB functionfs manager: greeter enumeration +
	  on-screen function (mtp/epass/fido) + re-enumeration.

	  Local source tree, override via local.mk OVERRIDE_SRCDIR.
```

## package/usb_aio_handler/Config.in.host
```kconfig
config BR2_PACKAGE_HOST_USB_AIO_HANDLER
	bool "host usb_aio_handler (usbaiohost)"
	help
	  PC-side USB client (pyhost) for the usb_aio_handler epass
	  mode: file transfer, remote command exec and device info
	  over the custom bulk protocol. Installs `usbaiohost` into
	  $(HOST_DIR)/bin. Needs libusb-1.0 on the build machine at
	  runtime.
```

## package/wch-riscv-toolchain/Config.in.host
```kconfig
config BR2_PACKAGE_HOST_WCH_RISCV_TOOLCHAIN_SUPPORTS
	bool
	default y if BR2_HOSTARCH = "x86_64"
```

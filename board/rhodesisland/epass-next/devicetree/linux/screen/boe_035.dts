// SPDX-License-Identifier: (GPL-2.0+ OR MIT)
/*
 * Screen overlay: BOE panel driven by a Sitronix ST7703, 720x1280 MIPI DSI,
 * 3 lanes. The prev-generation boards carry the same panel and call it
 * boe_035, so it keeps that name here -- the tooling above matches on it.
 *
 * Selected by the "screen" key in the bootenv partition; U-Boot pulls
 * fdt-screen-<screen> out of dtbs.itb and applies it over the base tree.
 *
 * The base revision tree already declared panel@0 with its reset line and its
 * supplies, because those are board wiring. All this adds is which panel is
 * on the other end.
 */
/dts-v1/;
/plugin/;

&panel {
	compatible = "rhodesisland,epassnext-panel";
	backlight = <&backlight>;
	rotation = <0>;

	/*
	 * What U-Boot's srgn_splash needs to light this panel before Linux:
	 * the video mode and the ST7703 DCS bring-up, kept next to the
	 * compatible so a different screen overlay carries its own numbers.
	 * The kernel driver ignores these; it has the same tables compiled in
	 * (drivers/gpu/drm/panel/panel-sitronix-st7703.c, epassnext entry) --
	 * if one changes, change both.
	 *
	 * timing: pclk_khz hact hfp hslen hbp vact vfp vslen vbp
	 */
	srgn,panel-timing = <64000 720 45 4 45 1280 30 8 20>;
	srgn,dsi-lanes = <3>;

	/* [delay_ms len <len DCS bytes>]*, delay after the write */
	srgn,init-sequence = [
		00 04 B9 F1 12 83
		00 06 B1 00 00 00 DA 80
		00 04 B2 C8 12 F0
		00 0B B3 10 10 28 28 03 FF 00 00 00 00
		00 02 B4 80
		00 03 B5 0A 0A
		00 03 B6 4B 4B
		00 05 B8 26 22 F0 63
		00 1C BA 32 81 05 F9 0E 0E 20 00 00 00 00 00
			 00 00 44 25 00 90 0A 00 00 01 4F 01
			 00 00 37
		00 02 BC 47
		00 04 BF 02 11 00
		00 0A C0 73 73 50 50 00 00 12 70 00
		00 0D C1 53 00 32 32 77 F4 FF FF CC CC 77 77
		00 07 C6 82 00 BF FF 00 FF
		00 07 C7 B8 00 0A 00 00 00
		00 05 C8 10 40 1E 02
		00 02 CC 0B
		00 23 E0 00 0B 12 25 30 39 42 37 07 0D 0D 11
			 13 10 12 12 19 00 0B 12 25 30 39 42
			 37 07 0D 0D 11 13 10 12 12 19
		00 0F E3 07 07 0B 0B 0B 0B 00 00 00 00 FF 00
			 C0 10
		00 40 E9 C8 10 10 05 0F 80 81 12 31 23 AF 8D
			 80 81 7F 10 03 00 19 00 00 00 03 00
			 19 00 00 00 4F 8A CA B7 58 31 75 31
			 31 88 88 4F 89 BA B6 48 20 64 20 20
			 88 88 00 00 00 00 00 80 81 00 00 00
			 00 00 00
		00 3E EA 96 1F 01 01 00 00 03 1C 43 03 03 00
			 48 F2 0A B0 28 46 02 46 9B 88 88 48
			 F3 1A B1 38 57 13 57 AC 88 88 23 10
			 00 00 74 00 00 00 00 00 00 0D 80 00
			 F0 00 05 04 12 30 70 80 81 70 80 81
			 00
		00 04 EF FF FF 01
		78 01 11
		14 01 29
	];
};
